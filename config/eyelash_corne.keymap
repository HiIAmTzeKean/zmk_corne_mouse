#define ZMK_POINTING_DEFAULT_MOVE_VAL 1200  // 600
#define ZMK_POINTING_DEFAULT_SCRL_VAL 25   // 10

#include <input/processors.dtsi>
#include <zephyr/dt-bindings/input/input-event-codes.h>
#include <behaviors.dtsi>
#include <dt-bindings/zmk/bt.h>
#include <dt-bindings/zmk/keys.h>
#include <dt-bindings/zmk/pointing.h>
#include <dt-bindings/zmk/rgb.h>

&mmv_input_listener { input-processors = <&zip_xy_scaler 2 1>; };

&msc_input_listener { input-processors = <&zip_scroll_scaler 2 1>; };

&msc {
    acceleration-exponent = <1>;      // 0
    time-to-max-speed-ms = <100>;       // 300
    delay-ms = <0>;                   // 0
};

&mmv {
    time-to-max-speed-ms = <500>;
    acceleration-exponent = <1>;
    trigger-period-ms = <16>;
};

/ {
    behaviors {
        shift_caps: compatible = "zmk,behavior-tap-dance";

        display-name = "Shift/Caps Lock Tap Dance";
        #binding-cells = <0>;
        bindings = <&kp LEFT_SHIFT>, <&kp CAPS>;

        tapping-term-ms = <250>;
    };
};

rgb_encoder: rgb_encoder {
    compatible = "zmk,behavior-sensor-rotate";
    #sensor-binding-cells = <0>;
    bindings = <&rgb_ug RGB_BRI>, <&rgb_ug RGB_BRD>;
};

scroll_encoder: scroll_encoder {
    compatible = "zmk,behavior-sensor-rotate";
    #sensor-binding-cells = <0>;
    bindings = <&msc SCRL_DOWN>, <&msc SCRL_UP>;

    tap-ms = <100>;
};

combos {
    compatible = "zmk,combos";

    qw_escape {
        bindings = <&kp ESC>;
        key-positions = <2 1>;
    };
};

keymap {
    compatible = "zmk,keymap";

    default_layer {
        display-name = "QWERTY";
        bindings = <
&kp TAB      &kp Q  &kp W  &kp E     &kp R  &kp T                               &kp UP                &kp Y        &kp U  &kp I      &kp O    &kp P     &kp BSPC
&shift_caps  &kp A  &kp S  &kp D     &kp F  &kp G                     &kp LEFT  &kp ENTER  &kp RIGHT  &kp H        &kp J  &kp K      &kp L    &kp SEMI  &kp RIGHT_SHIFT
&kp LCTRL    &kp Z  &kp X  &kp C     &kp V  &kp B        &kp SPACE              &kp DOWN              &kp N        &kp M  &kp COMMA  &kp DOT  &kp FSLH  &kp RIGHT_CONTROL
                           &kp LGUI  &mo 1  &lt 3 SPACE                                               &lt 3 ENTER  &mo 2  &kp RALT
        >;

        sensor-bindings = <&inc_dec_kp C_VOLUME_UP C_VOLUME_DOWN>;
    };

    lower_layer {
        display-name = "NUMBER";
        bindings = <
&trans  &kp N1  &kp N2        &kp N3        &kp N4        &kp N5                                      &mmv MOVE_UP                     &kp N6    &kp N7    &kp N8  &kp N9     &kp N0    &kp DEL
&trans  &trans  &bt BT_SEL 0  &bt BT_SEL 1  &bt BT_SEL 2  &bt BT_SEL 3                &mmv MOVE_LEFT  &mkp LCLK       &mmv MOVE_RIGHT  &kp LEFT  &kp DOWN  &kp UP  &kp RIGHT  &kp HOME  &kp PG_UP
&trans  &trans  &trans        &trans        &trans        &trans        &kp C_MUTE                    &mmv MOVE_DOWN                   &trans    &trans    &trans  &trans     &kp END   &kp PG_DN
                              &trans        &trans        &trans                                                                       &kp INS   &kp DEL   &trans
        >;

        sensor-bindings = <&scroll_encoder>;
    };

    raise_layer {
        display-name = "SYMBOL";
        bindings = <
&trans  &kp EXCL  &kp AT     &kp HASH       &kp DLLR   &kp PRCNT                                    &mmv MOVE_UP                     &kp CARET  &kp AMPS   &kp ASTRK  &kp LPAR  &kp RPAR  &kp BSPC
&trans  &trans    &mkp LCLK  &kp COLON      &kp GRAVE  &kp DOUBLE_QUOTES            &mmv MOVE_LEFT  &mkp LCLK       &mmv MOVE_RIGHT  &kp MINUS  &kp EQUAL  &kp LBKT   &kp RBKT  &kp BSLH  &trans
&trans  &trans    &trans     &kp SEMICOLON  &kp TILDE  &kp SINGLE_QUOTE   &trans                    &mmv MOVE_DOWN                   &kp UNDER  &kp PLUS   &kp LBRC   &kp RBRC  &kp PIPE  &trans
                             &trans         &trans     &kp SPACE                                                                     &kp RET    &trans     &trans
        >;

        sensor-bindings = <&scroll_encoder>;
    };

    layer_3 {
        display-name = "Fn";
        bindings = <
&studio_unlock  &kp F1      &kp F2     &kp F3     &kp F4            &kp F5                                    &mmv MOVE_UP                     &kp F6        &kp F7        &kp F8         &kp F9         &kp F10  &kp F11
&sys_reset      &trans      &mkp LCLK  &mkp MCLK  &mkp RCLK         &trans                    &mmv MOVE_LEFT  &mkp LCLK       &mmv MOVE_RIGHT  &bootloader   &mkp LCLK     &mkp MCLK      &mkp RCLK      &trans   &trans
&bootloader     &bt BT_CLR  &trans     &trans     &kp K_PLAY_PAUSE  &kp K_MUTE  &kp C_MUTE                    &mmv MOVE_DOWN                   &kp C_VOL_DN  &kp C_VOL_UP  &kp C_BRI_DEC  &kp C_BRI_INC  &trans   &trans
                                       &trans     &trans            &trans                                                                     &trans        &trans        &trans
        >;

        sensor-bindings = <&scroll_encoder>;
    };
};

};
