## boards/arm/mouse_corne/Kconfig.board
```kconfig
#
# Copyright (c) 2024 The ZMK Contributors
# SPDX-License-Identifier: MIT
#

config BOARD_MOUSE_CORNE_LEFT
    bool "mouse_corne left"
    depends on SOC_NRF52840_QIAA

config BOARD_MOUSE_CORNE_RIGHT
    bool "mouse_corne right"
    depends on SOC_NRF52840_QIAA
```

## config/west.yml
```yaml
manifest:
  remotes:
    - name: zmkfirmware
      url-base: https://github.com/zmkfirmware
  projects:
    - name: mouse_corne
      url: https://github.com/HiIAmTzeKean/zmk_corne_mouse
      revision: main
    - name: zmk
      remote: zmkfirmware
      revision: main
      import: app/west.yml
  self:
    path: config
```
